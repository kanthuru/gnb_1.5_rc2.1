## SRC-GNB-PLFM-B0-v1.5.0-RC2.1/u-boot/configs/edgeq_raptor2_b0_titan_defconfig
```kconfig
CONFIG_ARM=y
# CONFIG_ARM64_SUPPORT_AARCH32 is not set
CONFIG_ARCH_RAPTOR2=y
CONFIG_SYS_TEXT_BASE=0x801C00000
CONFIG_ENV_SIZE=0x2000
CONFIG_NR_DRAM_BANKS=1
CONFIG_TARGET_EQ_RAPTOR2_B0=y
CONFIG_TARGET_EQ_RAPTOR2_B0_TITAN=y
CONFIG_DISTRO_DEFAULTS=y
CONFIG_FIT=y
CONFIG_BOOTDELAY=3
CONFIG_USE_BOOTARGS=y
CONFIG_BOOTARGS="console=ttyS0,115200 root=/dev/ram0 earlycon=edgeq8250,mmio32,0x6E450000"
CONFIG_CMD_EEPROM=y
CONFIG_CMD_EEPROM_LAYOUT=y
CONFIG_EEPROM_LAYOUT_HELP_STRING="v1"
CONFIG_DEFAULT_DEVICE_TREE="edgeq_raptor2_b0_titan"
CONFIG_OF_LIST="edgeq_raptor2_b0_titan"
CONFIG_SYS_CONFIG_NAME="edgeq_raptor2"
CONFIG_DM=y
CONFIG_NETDEVICES=y
CONFIG_BAUDRATE=115200
CONFIG_DM_ETH=y
CONFIG_DWXGMAC=y
CONFIG_EQXPCS=y
CONFIG_DM_ETH_PHY=y
CONFIG_PHY_MV88X7121=y
CONFIG_DM_MDIO=y
CONFIG_DM_SERIAL=y
#CONFIG_PL01X_SERIAL=y
CONFIG_SYS_NS16550=y
CONFIG_SYS_NS16550_SERIAL=y
# CONFIG_CMD_SMC=y
CONFIG_DM_SPI=y
CONFIG_ATCSPI200_SPI=y
CONFIG_DM_SPI_FLASH=y
CONFIG_SPI_FLASH_MACRONIX=y
CONFIG_SPI_FLASH_STMICRO=y
CONFIG_MTD_SPI_NAND=y
CONFIG_SPI_FLASH_MTD=y
CONFIG_DM_MMC=y
CONFIG_MTD=y
CONFIG_DM_MTD=y
CONFIG_CMD_SPI=y
CONFIG_CMD_SF=y
CONFIG_CLK=y
CONFIG_CMD_RAPTOR_FUSE=y
CONFIG_CMD_SMC=y
#SPI configs
CONFIG_SPI=y
CONFIG_SPI_FLASH=y
CONFIG_SPI_FLASH_ISSI=y
CONFIG_SPI_FLASH_WINBOND=y
CONFIG_CMD_SF_TEST=y
CONFIG_EDGEQ_APB_ADDRESSING=y
CONFIG_BOOTP_PXE=n
CONFIG_BOOTM_EFI=n
CONFIG_CMD_BOOTEFI=n
CONFIG_CMD_BOOTEFI_HELLO_COMPILE=n
CONFIG_EFI_PARTITION=n
CONFIG_EFI_LOADER=n
CONFIG_BOOTM_NETBSD=n
CONFIG_BOOTM_PLAN9=n
CONFIG_BOOTM_RTEMS=n
CONFIG_BOOTM_VXWORKS=n
CONFIG_CMD_XIMG=n
CONFIG_FIT=n
#CONFIG_ENV_IS_IN_SPI_FLASH=y
#512KB env size in flash
CONFIG_ENV_SIZE=0x40000
#CONFIG_ENV_SECT_SIZE=0x1000
#2MB offset in flash
#CONFIG_ENV_OFFSET=0x200000
CONFIG_DM_I2C=y
CONFIG_CMD_I2C=y
CONFIG_CMD_EEPROM=y
CONFIG_I2C_SET_DEFAULT_BUS_NUM=y
CONFIG_I2C_DEFAULT_BUS_NUMBER=0
CONFIG_MISC=y
CONFIG_I2C_EEPROM=y
CONFIG_SYS_I2C_EEPROM_BUS=0
CONFIG_SYS_I2C_EEPROM_ADDR=0x50
CONFIG_SYS_EEPROM_SIZE=1024
CONFIG_SYS_EEPROM_PAGE_WRITE_BITS=8
CONFIG_SYS_EEPROM_PAGE_WRITE_DELAY_MS=5
CONFIG_SYS_I2C_EEPROM_ADDR_LEN=2
CONFIG_ARM64=y
CONFIG_SYS_I2C_EDGEQ=y
CONFIG_CMD_MEMTEST=y
CONFIG_CMD_CACHE=y
CONFIG_MMC=y
CONFIG_DM_MMC=y
CONFIG_CMD_MMC=y
CONFIG_MMC_SDHCI=y
CONFIG_MMC_SDHCI_RAPTOR2=y
CONFIG_CMD_EXT4_WRITE=y
CONFIG_FAT_WRITE=y
#CONFIG_MMC_SDHCI_ADMA=y
#CONFIG_DMA_ADDR_T_64BIT=y
CONFIG_CMD_SET_VDD=y
CONFIG_CMD_SET_AVS=y
CONFIG_CMD_GPT=y
CONFIG_CMD_GPT_RENAME=y
CONFIG_FIT=y
CONFIG_FIT_VERBOSE=y
#DCTCXO I2C bus line & slave address
CONFIG_I2C_DCTCXO=y
CONFIG_CMD_BSS_REG_READ_WRITE=y
```

## SRC-GNB-PLFM-B0-v1.5.0-RC2.1/u-boot/configs/edgeq_raptor2_defconfig
```kconfig
CONFIG_ARM=y
# CONFIG_ARM64_SUPPORT_AARCH32 is not set
CONFIG_ARCH_RAPTOR2=y
CONFIG_SYS_TEXT_BASE=0x400a00000
CONFIG_ENV_SIZE=0x2000
CONFIG_NR_DRAM_BANKS=1
CONFIG_TARGET_EQ_RAPTOR2=y
CONFIG_DISTRO_DEFAULTS=y
CONFIG_FIT=y
CONFIG_BOOTDELAY=3
CONFIG_USE_BOOTARGS=y
CONFIG_BOOTARGS="console=ttyS0,115200 root=/dev/ram0 earlycon=pl011,mmio,0x70400000"
CONFIG_DEFAULT_DEVICE_TREE="edgeq_raptor2"
CONFIG_DM=y
# CONFIG_NETDEVICES is not set
CONFIG_BAUDRATE=1152000
CONFIG_DM_SERIAL=y
CONFIG_PL01X_SERIAL=y
CONFIG_SYS_NS16550=y
CONFIG_SYS_NS16550_SERIAL=y
# CONFIG_CMD_SMC=y
CONFIG_DM_SPI=y
CONFIG_ATCSPI200_SPI=y
CONFIG_DM_SPI_FLASH=y
CONFIG_SPI_FLASH_MACRONIX=y
CONFIG_SPI_FLASH_STMICRO=y
CONFIG_MTD_SPI_NAND=y
CONFIG_SPI_FLASH_MTD=y
CONFIG_DM_MMC=y
CONFIG_MTD=y
CONFIG_DM_MTD=y
CONFIG_CMD_SPI=y
CONFIG_CMD_SF=y
CONFIG_CLK=y
CONFIG_CMD_RAPTOR_FUSE=y
```
