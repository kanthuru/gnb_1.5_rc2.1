## SRC-GNB-PLFM-B0-v1.5.0-RC2.1/linux/Documentation/devicetree/bindings/pci/raptor2-pcie-rc.yaml
```yaml
# SPDX-License-Identifier: (GPL-2.0-only OR BSD-2-Clause)
%YAML 1.2
---
$id: http://devicetree.org/schemas/pci/raptor2-pcie-rc.yaml#
$schema: http://devicetree.org/meta-schemas/core.yaml#

title: Raptor2 PCI Root Complex Schema

description: |
  This YAML file describes the device tree binding for the Raptor2 PCIe Root Complex.

maintainers:
  - Aman Sharma <aman.Sharma@edgeq.io>
  - Aakash Verma <aakash.verma@edgeq.io>

properties:
  $nodename:
    pattern: "^raptor2-pcie-rc@"

  reg:
    maxItems: 6
    items:
      - description: IP reg DBI
      - description: Configuration space
      - description: IP reg ATU
      - description: Port Configuration
      - description: PCIe L4 Control Registers
      - description: SIF Control Registers

  reg-names:
    items:
      - const: "dbi"
      - const: "config"
      - const: "atu"
      - const: "port_cfg"
      - const: "lk_reg"
      - const: "sif_ctrl"

  dma-coherent: true

  num-lanes:
    description: Number of PCIe lanes
    $ref: /schemas/types.yaml#/definitions/uint8
    minimum: 1
    default: 1
    maximum: 16

  dma-ch:
    description: Maximum number of DMA channels
    $ref: /schemas/types.yaml#/definitions/uint32
    type: integer
    minimum: 1
    default: 8
    maximum: 32

  max-ch-mem:
    description: Maximum memory allocated to DMA channels
    $ref: /schemas/types.yaml#/definitions/uint32
    type: integer
    minimum: 1
    default: 131072
    minimum: 131072
    maximum: 2147483647

  ddr-addr:
    description: BAR2 DDR address
    $ref: /schemas/types.yaml#/definitions/uint64
    type: integer
    minimum: 1
    default: 34359738368
    maximum: 34359738368

  ddr-size:
    description: BAR2 DDR size
    $ref: /schemas/types.yaml#/definitions/uint64
    type: integer
    minimum: 1
    default: 8589934592
    maximum: 8589934592

  dma-ll-addr:
    description: Link List for DMA, in DDR address
    $ref: /schemas/types.yaml#/definitions/uint64
    type: integer
    minimum: 0
    maximum: 4294967295

  dma-ll-size:
    description: Link List for DMA, in DDR size
    $ref: /schemas/types.yaml#/definitions/uint64
    type: integer
    minimum: 0
    maximum: 2147483647

  hdma-reg-addr:
    description: HDMA reg address
    $ref: /schemas/types.yaml#/definitions/uint32
    type: integer
    minimum: 0
    maximum: 4294967295

  hdma-reg-size:
    description: HDMA reg size
    $ref: /schemas/types.yaml#/definitions/uint32
    type: integer
    minimum: 0
    maximum: 524287

  ep-off-addr:
    description: Endpoint Offset Addr
    $ref: /schemas/types.yaml#/definitions/uint64
    type: integer
    minimum: 0
    maximum: 16777215

  ep-off-size:
    description: Endpoint Offset Size
    $ref: /schemas/types.yaml#/definitions/uint64
    type: integer
    minimum: 0
    maximum: 262143

  max-functions:
    description: Maximum number of functions that can be configured
    $ref: /schemas/types.yaml#/definitions/uint8
    type: integer
    minimum: 1
    default: 1
    maximum: 255

  max-link-speed:
    $ref: /schemas/types.yaml#/

examples:
  - |
  pcie1: pcie@3C600000 {
      compatible = "raptor2-pcie-rc";
      reg = <0x0 0x3C600000 0x0 0x100000>,     /* IP reg DBI SZ 1MB */
            <0x60 0x00000000 0x0 0x09000000>, /* Configuration space */
            <0x0 0x3C900000 0x0 0x80000>,     /* IP reg 2 ATU SZ 512K */
            <0x0 0x3CB00000 0x0 0x40000>,     /* Port Bringup Configuration */
            <0x0 0x3C4C0000 0x0 0x20000>,     /* PCIE_L4_CNTL_REG */
            <0x0 0x3CB20000 0x0 0x20>;        /* SIF control registers */
      reg-names = "dbi", "config", "atu", "br_up", "lk_reg", "sif_ctrl";

      bus-range = <0x0 0x2>;
      #address-cells = <3>;
      #size-cells = <2>;
      device_type = "pci";
      dma-coherent;

      /* Outbound */
      ranges = <0x81000000 0x0 0x00000000 0x60 0x09000000
                0x0 0x00010000 /* io 64KB */
                0x02000000 0x0 0x20000000 0x60 0x0A000000
                0x0 0x20000000 /* 32bit non pref mem 512M */
                0x43000000 0x60 0x40000000 0x60 0x40000000
                0x10 0x00000000>; /* 64bit pref mem 64GB */

      num-windows = <0x10>; /* ATU ib/ob windows */
      interrupt-names = "intx", "msi0";
      interrupts = <GIC_SPI 423 1>, <GIC_SPI 424 1>;
      #msi-parent = <&gic>;
      #interrupt-cells = <1>;
      interrupt-parent = <&gic>;
      interrupt-map-mask = <0 0 0 7>;
      interrupt-map = <0 0 0 1 &gic 0x0 0x0 GIC_SPI 423 1>,
                      <0 0 0 2 &gic 0x0 0x0 GIC_SPI 422 1>,
                      <0 0 0 3 &gic 0x0 0x0 GIC_SPI 421 1>,
                      <0 0 0 4 &gic 0x0 0x0 GIC_SPI 420 1>;

      linux,pci-domain = <0>;
      raptor2_early_init;
      num-lanes = <4>;
      status = "disabled";
  };
```

## SRC-GNB-PLFM-B0-v1.5.0-RC2.1/linux/arch/arm64/boot/raptor2-B0.its
```
// SPDX-License-Identifier: GPL-2.0
/*
 * EdgeQ Inc.
 *
 *
 * Raptor2 Platform
 */

/dts-v1/;

/ {
        description = "EdgeQ Inc. Raptor2 FIT Image";
        #address-cells = <2>;

        images {
                kernel {
                        description = "Kernel";
                        data = /incbin/("Image");
                        type = "kernel";
                        arch = "arm64";
                        os = "linux";
                        compression = "none";
                        load = <0x00000008 0x12000000>;
                        entry = <0x00000008 0x12000000>;
                        hash {
                                algo = "sha1";
                        };
                };
		b0_hawk_fdt {
                        description = "DTB";
                        data = /incbin/("dts/edgeq/raptor2-B0-hawk.dtb");
                        type = "flat_dt";
                        arch = "arm64";
                        os = "linux";
                        compression = "none";
                        load = <0x00000008 0x11000000>;
                        hash {
                                algo = "sha1";
                        };
                };
		initrd {
			description = "initrd for arm64";
			data = /incbin/("rootfs.cpio.gz");
			type = "ramdisk";
			arch = "arm64";
			os = "linux";
			compression = "gzip";
			load = <0x00000008 0x16000000>;
			entry = <0x00000008 0x16000000>;
			hash {
				algo = "sha1";
			};
		};
	};

        configurations {
                default = "standard";
		b0_hawk {
                        description = "Hawk Raptor2 Boot";
                        kernel = "kernel";
                        fdt = "b0_hawk_fdt";
			ramdisk = "initrd";
                        hash {
                                algo = "sha1";
                        };
                };
        };

};
```

## SRC-GNB-PLFM-B0-v1.5.0-RC2.1/linux/drivers/crypto/edgeq/Kconfig
```kconfig
config CRYPTO_DEV_RAPTOR2_CRSS
	bool "Support for EdgeQ Raptor2 CRSS"
	select CRYPTO_AEAD
	select CRYPTO_AES
	select CRYPTO_AUTHENC
	select CRYPTO_SKCIPHER
	select CRYPTO_CBC
	select CRYPTO_CTR
	select CRYPTO_SEQIV
	select CRYPTO_GCM
	default y
	help
	  This option enables support for the EdgeQ CRSS crypto accelerator
	  in the Raptor2 SoC devices. It allows the crypto hardware offload
	  for the generic tranformations (like ctr(aes), gcm(aes), etc) as
	  well as the transformations for IPSEC ESP (like rfc4106(gcm(aes))).
```

## SRC-GNB-PLFM-B0-v1.5.0-RC2.1/linux/drivers/net/ethernet/edgeq/Kconfig
```kconfig
# SPDX-License-Identifier: GPL-2.0-only
#
# EdgeQ network device configuration
#

config NET_VENDOR_EDGEQ
	bool "EdgeQ devices"
	default y
	depends on ARM64 && HAS_IOMEM
	help
	  If you have a network (Ethernet) based on EdgeQ SoC (which uses
	  Synopsys Ethernet IP Cores), say Y.

	  Note that the answer to this question doesn't directly affect the
	  kernel: saying N will just cause the configurator to skip all
	  the questions about EdgeQ chipset. If you say Y, you will
	  be asked for your specific chipset in the following questions.

if NET_VENDOR_EDGEQ

source "drivers/net/ethernet/edgeq/xgbe/Kconfig"

endif # NET_VENDOR_EDGEQ
```

## SRC-GNB-PLFM-B0-v1.5.0-RC2.1/linux/drivers/net/ethernet/edgeq/xgbe/Kconfig
```kconfig
# SPDX-License-Identifier: GPL-2.0-only
#
# EdgeQ network device
#

config EDGEQ_XGBE
	tristate "EdgeQ 10GbE Ethernet driver"
	default y
	depends on OF_NET && OF_ADDRESS && HAS_IOMEM
	depends on ARM64 || COMPILE_TEST
        select MII
        select MDIO_XPCS
        select PAGE_POOL
	select CRC32
	imply PTP_1588_CLOCK
	help
	  This is the driver for the XGMAC Ethernet IP block found on EdgeQ
	  Raptor platforms.
```

## SRC-GNB-PLFM-B0-v1.5.0-RC2.1/linux/drivers/pci/endpoint/functions/Kconfig
```kconfig
# SPDX-License-Identifier: GPL-2.0
#
# PCI Endpoint Functions
#

config PCI_EPF_TEST
	tristate "PCI Endpoint Test driver"
	depends on PCI_ENDPOINT
	select CRC32
	help
	   Enable this configuration option to enable the test driver
	   for PCI Endpoint.

	   If in doubt, say "N" to disable Endpoint test driver.

config PCI_EPF_EDGEQ
	tristate "PCI Endpoint driver for EDGEQ Raptor 2"
	depends on PCI_ENDPOINT
	default y if ARCH_EDGEQ
	select CRC32
	help
	   Enable this configuration option to enable the test driver
	   for PCI Endpoint.

	   If in doubt, say "N" to disable Endpoint test driver.

config PCI_EPF_EDGEQ_TEST
	tristate "PCI Endpoint Test driver for EDGEQ Raptor 2"
	depends on PCI_ENDPOINT && ARCH_EDGEQ && !PCI_EPF_EDGEQ
	select CRC32
	help
	   Enable this configuration option to enable the test driver
	   for PCI Endpoint.

	   If in doubt, say "N" to disable Endpoint test driver.
```

## SRC-GNB-PLFM-B0-v1.5.0-RC2.1/linux/drivers/soc/edgeq/Kconfig
```kconfig
# Raptor-2
menu "Enable EdgeQ SoC drivers"

source "drivers/soc/edgeq/bsscmdq/Kconfig"
source "drivers/soc/edgeq/sumgr/Kconfig"
#source "drivers/soc/edgeq/logger/Kconfig"
source "drivers/soc/edgeq/shmtest/Kconfig"
source "drivers/soc/edgeq/exmgr/Kconfig"
source "drivers/soc/edgeq/test_wlan/Kconfig"
source "drivers/soc/edgeq/eeprom/Kconfig"
source "drivers/soc/edgeq/heartbeat/Kconfig"

endmenu
```

## SRC-GNB-PLFM-B0-v1.5.0-RC2.1/linux/drivers/soc/edgeq/bsscmdq/Kconfig
```kconfig
# Raptor-2
config EDGEQ_RAPTOR2_BSS_CMDQ
		bool "Kernel Driver for BSS RT Command Queue"
		default y
		depends on ARCH_EDGEQ
		help
		Kernel Driver for BSS RT Command Queue.
		Communicate with BSS RT for SU infra, reset,
		Load SU firmware, License suthentication,
		EFUSE operations etc.
```

## SRC-GNB-PLFM-B0-v1.5.0-RC2.1/linux/drivers/soc/edgeq/eeprom/Kconfig
```kconfig
# Raptor-2
config EDGEQ_RAPTOR2_EEPROM
		bool "Support for exposing EEPROM Data to userspace"
		default y
		depends on ARCH_EDGEQ
		depends on EDGEQ_RAPTOR2
```

## SRC-GNB-PLFM-B0-v1.5.0-RC2.1/linux/drivers/soc/edgeq/exmgr/Kconfig
```kconfig
# Raptor-2
config EDGEQ_RAPTOR2_EXMGR
	bool "Support for EdgeQ Raptor2 Exception Manager"
	default y
	depends on ARCH_EDGEQ
	help
	Enables Exception Handler Module
```

## SRC-GNB-PLFM-B0-v1.5.0-RC2.1/linux/drivers/soc/edgeq/heartbeat/Kconfig
```kconfig
#Raptor-2
config EDGEQ_RAPTOR2_HEARTBEAT
	bool "Support for EdgeQ Raptor2 Heartbeat from userspace"
	default y
	depends on ARCH_EDGEQ
	depends on EDGEQ_RAPTOR2
	help
	Enables heartbeat support from linux userspace.
	The value 0 from linux userspace tells to
	start WDT and 1 represents to stop WDT.
	It shows whether Heartbeat message is sent or not yet sent.
```

## SRC-GNB-PLFM-B0-v1.5.0-RC2.1/linux/drivers/soc/edgeq/logger/Kconfig
```kconfig
# Raptor-2
config EDGEQ_RAPTOR2_LOGGER
	bool "Support for EdgeQ Raptor2 Logger"
	default n
	#default y if ARCH_EDGEQ
```

## SRC-GNB-PLFM-B0-v1.5.0-RC2.1/linux/drivers/soc/edgeq/shmtest/Kconfig
```kconfig
# Raptor-2
config EDGEQ_RAPTOR2_WLAN_SHM
	bool "Support for EdgeQ Raptor2 WLAN SHM"
	default n
	#default y if ARCH_EDGEQ
```

## SRC-GNB-PLFM-B0-v1.5.0-RC2.1/linux/drivers/soc/edgeq/sumgr/Kconfig
```kconfig
# Raptor-2
config EDGEQ_RAPTOR2
	bool "Support for EdgeQ Raptor2 SoC"
	default y if ARCH_EDGEQ
```

## SRC-GNB-PLFM-B0-v1.5.0-RC2.1/linux/drivers/soc/edgeq/test_wlan/Kconfig
```kconfig
# Raptor-2
config EDGEQ_RAPTOR2_TEST_WLAN
	bool "Support for EdgeQ Raptor2 WLAN Test"
	default n
	depends on ARCH_EDGEQ
	help
	Enables Test WLAN Module
```

## SRC-GNB-PLFM-B0-v1.5.0-RC2.1/u-boot/arch/arm/mach-raptor2/Kconfig
```kconfig
if ARCH_RAPTOR2

config SYS_VENDOR
        default "edgeq"

config RAPTOR_FAMILY
	def_bool y

choice
	prompt "EdgeQ chip version select"
	optional

config TARGET_EQ_RAPTOR2_A0
	bool "Support EdgeQ Raptor 2 A0 Silicon"
	help
	  Support for EdgeQ Raptor 2 A0 Silicon

config TARGET_EQ_RAPTOR2_B0
	bool "Support EdgeQ Raptor 2 B0 Silicon"
	help
	  Support for EdgeQ Raptor 2 B0 Silicon.
endchoice

if TARGET_EQ_RAPTOR2_A0

choice
	prompt "EdgeQ A0 board select"
	optional

config TARGET_EQ_RAPTOR2
	bool "Support EdgeQ Raptor 2 SoC"
	select ARCH_SUPPORT_TFABOOT
	select SUPPORT_SPL
	select BOARD_EARLY_INIT_F
	select BOARD_LATE_INIT
	select MISC_INIT_R
	help
	  Support for EdgeQ Raptor 2 board.

config TARGET_EQ_RAPTOR2_FPGA
	bool "Support EdgeQ Raptor 2 FPGA"
	select ARCH_SUPPORT_TFABOOT
	select SUPPORT_SPL
	select BOARD_EARLY_INIT_F
	select BOARD_LATE_INIT
	select MISC_INIT_R
	help
	  Support for EdgeQ Raptor 2 fpga board.

config TARGET_EQ_RAPTOR2_SINGLE_PPU_CLUSTER
	bool "Support EdgeQ Raptor 2 Single PPU Cluster"
	select ARCH_SUPPORT_TFABOOT
	select SUPPORT_SPL
	select BOARD_EARLY_INIT_F
	select BOARD_LATE_INIT
	select MISC_INIT_R
	help
	  Support for EdgeQ Raptor Single PPU cluster board.

config TARGET_EQ_RAPTOR2_A0_EVB
	bool "Support EdgeQ Raptor 2 A0 EVB"
	select ARCH_SUPPORT_TFABOOT
	select SUPPORT_SPL
	select BOARD_EARLY_INIT_F
	select BOARD_LATE_INIT
	select MISC_INIT_R
	help
	  Support for EdgeQ Raptor 2 A0 EVB

config TARGET_EQ_RAPTOR2_A0_PEGASUS
	bool "Support EdgeQ Raptor 2 A0 Pegasus"
	select ARCH_SUPPORT_TFABOOT
	select SUPPORT_SPL
	select BOARD_EARLY_INIT_F
	select BOARD_LATE_INIT
	select MISC_INIT_R
	help
	  Support for EdgeQ Raptor 2 A0 Pegasus board
	  This option assumes uboot is configured to use the
	  bss UART (ns16550) for the serial console.
endchoice

endif

if TARGET_EQ_RAPTOR2_B0

choice
	prompt "EdgeQ B0 board select"
	optional

config TARGET_EQ_RAPTOR2_B0_FPGA
	bool "Support EdgeQ Raptor 2 B0 FPGA"
	select ARCH_SUPPORT_TFABOOT
	select SUPPORT_SPL
	select BOARD_EARLY_INIT_F
	select BOARD_LATE_INIT
	select MISC_INIT_R
	help
	  Support for EdgeQ Raptor 2 B0 fpga board.

config TARGET_EQ_RAPTOR2_B0_TITAN
	bool "Support EdgeQ Raptor 2 B0 Titan"
	select ARCH_SUPPORT_TFABOOT
	select SUPPORT_SPL
	select BOARD_EARLY_INIT_F
	select BOARD_LATE_INIT
	select MISC_INIT_R
	help
	  Support for EdgeQ Raptor 2 B0 Titan board.

config TARGET_EQ_RAPTOR2_B0_HAWK
	bool "Support EdgeQ Raptor 2 B0 Hawk"
	select ARCH_SUPPORT_TFABOOT
	select SUPPORT_SPL
	select BOARD_EARLY_INIT_F
	select BOARD_LATE_INIT
	select MISC_INIT_R
	help
	  Support for EdgeQ Raptor 2 B0 Hawk board.
	  This option assumes uboot is configured to use the
	  bss UART (ns16550) for the serial console.

config TARGET_EQ_RAPTOR2_B0_PEGASUS
	bool "Support EdgeQ Raptor 2 B0 Pegasus"
	select ARCH_SUPPORT_TFABOOT
	select SUPPORT_SPL
	select BOARD_EARLY_INIT_F
	select BOARD_LATE_INIT
	select MISC_INIT_R
	help
	  Support for EdgeQ Raptor 2 B0 Pegasus board.
endchoice

endif

source "board/edgeq/raptor2/Kconfig"

endif
```
