## SRC-GNB-PLFM-B0-v1.5.0-RC2.1/buildroot/configs/edgeq_r2_flasher_defconfig
```kconfig
BR2_aarch64=y
BR2_neoverse_n1=y
BR2_CCACHE=y
BR2_TOOLCHAIN_EXTERNAL=y
BR2_ROOTFS_MERGED_USR=y
BR2_SYSTEM_DEFAULT_PATH="/bin:/sbin:/usr/bin:/usr/sbin"
BR2_ROOTFS_OVERLAY="board/edgecompute/raptor2/rootfs-overlay/"
BR2_PACKAGE_E2FSPROGS=y
# BR2_PACKAGE_E2FSPROGS_FSCK is not set
BR2_PACKAGE_MTD=y
BR2_PACKAGE_MTD_MTDPART=y
# BR2_PACKAGE_MTD_NANDDUMP is not set
# BR2_PACKAGE_MTD_NANDTEST is not set
# BR2_PACKAGE_MTD_NANDWRITE is not set
# BR2_PACKAGE_MTD_UBIATTACH is not set
# BR2_PACKAGE_MTD_UBICRC32 is not set
# BR2_PACKAGE_MTD_UBIDETACH is not set
# BR2_PACKAGE_MTD_UBIFORMAT is not set
# BR2_PACKAGE_MTD_UBIMKVOL is not set
# BR2_PACKAGE_MTD_UBINFO is not set
# BR2_PACKAGE_MTD_UBINIZE is not set
# BR2_PACKAGE_MTD_UBIRENAME is not set
# BR2_PACKAGE_MTD_UBIRMVOL is not set
# BR2_PACKAGE_MTD_UBIRSVOL is not set
# BR2_PACKAGE_MTD_UBIUPDATEVOL is not set
# BR2_PACKAGE_MTD_UBIBLOCK is not set
BR2_PACKAGE_GPTFDISK=y
BR2_PACKAGE_GPTFDISK_GDISK=y
BR2_PACKAGE_GPTFDISK_SGDISK=y
BR2_PACKAGE_GPTFDISK_CGDISK=y
BR2_PACKAGE_ZLIB=y
BR2_PACKAGE_HAVEGED=y
# BR2_PACKAGE_IFUPDOWN_SCRIPTS is not set
# BR2_PACKAGE_URANDOM_SCRIPTS is not set
BR2_PACKAGE_UTIL_LINUX_BINARIES=y
BR2_TARGET_ROOTFS_CPIO=y
BR2_TARGET_ROOTFS_CPIO_GZIP=y
BR2_TARGET_ROOTFS_CPIO_UIMAGE=y
```

## SRC-GNB-PLFM-B0-v1.5.0-RC2.1/buildroot/configs/edgeq_r2_minimal_defconfig
```kconfig
BR2_aarch64=y
BR2_neoverse_n1=y
BR2_TOOLCHAIN_EXTERNAL=y
BR2_ROOTFS_MERGED_USR=y
BR2_SYSTEM_DEFAULT_PATH="/bin:/sbin:/usr/bin:/usr/sbin"
BR2_PACKAGE_BUSYBOX_SHOW_OTHERS=y
BR2_PACKAGE_HWDATA=y
BR2_PACKAGE_I2C_TOOLS=y
BR2_PACKAGE_PCIUTILS=y
BR2_PACKAGE_LIBPCIACCESS=y
BR2_PACKAGE_READLINE=y
# BR2_PACKAGE_IFUPDOWN_SCRIPTS is not set
# BR2_PACKAGE_URANDOM_SCRIPTS is not set
BR2_PACKAGE_UTIL_LINUX=y
BR2_PACKAGE_UTIL_LINUX_SCHEDUTILS=y
BR2_TARGET_ROOTFS_CPIO=y
```

## SRC-GNB-PLFM-B0-v1.5.0-RC2.1/buildroot/configs/edgeq_raptor2_defconfig
```kconfig
BR2_aarch64=y
BR2_neoverse_n1=y
BR2_TOOLCHAIN_EXTERNAL=y
BR2_PACKAGE_HOST_GDB=y
BR2_PACKAGE_HOST_GDB_PYTHON3=y
BR2_GDB_VERSION_10=y
BR2_TARGET_GENERIC_HOSTNAME="raptor2"
BR2_TARGET_GENERIC_ISSUE="EdgeQ Raptor2 System Initializing..."
BR2_INIT_SYSTEMD=y
BR2_TARGET_GENERIC_ROOT_PASSWD="root"
BR2_SYSTEM_DEFAULT_PATH="/bin:/sbin:/usr/bin:/usr/sbin"
BR2_GENERATE_LOCALE="en_US"
BR2_ROOTFS_USERS_TABLES="board/edgecompute/raptor2/usertable"
BR2_ROOTFS_OVERLAY="board/edgecompute/raptor2/rootfs-overlay/"
BR2_ROOTFS_POST_BUILD_SCRIPT="board/edgecompute/raptor2/post_build.sh"
BR2_LINUX_KERNEL=y
BR2_LINUX_KERNEL_CUSTOM_VERSION=y
BR2_LINUX_KERNEL_CUSTOM_VERSION_VALUE="5.11.5"
BR2_LINUX_KERNEL_USE_ARCH_DEFAULT_CONFIG=y
BR2_PACKAGE_LINUX_TOOLS_GPIO=y
BR2_PACKAGE_LINUX_TOOLS_PCI=y
BR2_PACKAGE_LINUX_TOOLS_PERF=y
BR2_PACKAGE_LINUX_TOOLS_PERF_TUI=y
BR2_PACKAGE_GSTREAMER1=y
BR2_PACKAGE_GST1_PLUGINS_BAD=y
BR2_PACKAGE_DROPWATCH=y
BR2_PACKAGE_FIO=y
BR2_PACKAGE_GDB=y
BR2_PACKAGE_GDB_SERVER=y
BR2_PACKAGE_GDB_DEBUGGER=y
BR2_PACKAGE_GDB_TUI=y
BR2_PACKAGE_GDB_PYTHON=y
BR2_PACKAGE_IOZONE=y
BR2_PACKAGE_STRACE=y
BR2_PACKAGE_VALGRIND=y
BR2_PACKAGE_E2FSPROGS=y
BR2_PACKAGE_E2FSPROGS_DEBUGFS=y
BR2_PACKAGE_E2FSPROGS_E2IMAGE=y
BR2_PACKAGE_E2FSPROGS_E4DEFRAG=y
BR2_PACKAGE_E2FSPROGS_FUSE2FS=y
BR2_PACKAGE_E2FSPROGS_RESIZE2FS=y
BR2_PACKAGE_MMC_UTILS=y
BR2_PACKAGE_MTD=y
BR2_PACKAGE_NFS_UTILS=y
# BR2_PACKAGE_NFS_UTILS_RPC_NFSD is not set
BR2_PACKAGE_I2C_TOOLS=y
BR2_PACKAGE_LM_SENSORS=y
BR2_PACKAGE_LM_SENSORS_FANCONTROL=y
BR2_PACKAGE_LM_SENSORS_PWMCONFIG=y
BR2_PACKAGE_LM_SENSORS_SENSORS_DETECT=y
BR2_PACKAGE_PPS_TOOLS=y
BR2_PACKAGE_SPI_TOOLS=y
BR2_PACKAGE_SYSSTAT=y
BR2_PACKAGE_PERL=y
BR2_PACKAGE_PYTHON3_CURSES=y
BR2_PACKAGE_PYTHON3_READLINE=y
BR2_PACKAGE_PYTHON_NUMPY=y
BR2_PACKAGE_PYTHON_PIP=y
BR2_PACKAGE_TCL=y
BR2_PACKAGE_EXPECT=y
BR2_PACKAGE_TCLLIB=y
BR2_PACKAGE_CA_CERTIFICATES=y
BR2_PACKAGE_LIBSSH=y
BR2_PACKAGE_LIBSSH_SERVER=y
BR2_PACKAGE_LIBSSH2=y
BR2_PACKAGE_LIBCONFIG=y
BR2_PACKAGE_CAIRO=y
BR2_PACKAGE_CAIRO_SCRIPT=y
BR2_PACKAGE_LIBGPIOD=y
BR2_PACKAGE_LIBGPIOD_TOOLS=y
BR2_PACKAGE_LIBXSLT=y
BR2_PACKAGE_LIBCURL=y
BR2_PACKAGE_LIBNETCONF2=y
BR2_PACKAGE_LKSCTP_TOOLS=y
BR2_PACKAGE_LIBSECCOMP=y
BR2_PACKAGE_LIBUNWIND=y
BR2_PACKAGE_LINUX_PAM=y
BR2_PACKAGE_COLLECTD=y
BR2_PACKAGE_COLLECTD_HUGEPAGES=y
BR2_PACKAGE_HAVEGED=y
BR2_PACKAGE_XUTIL_UTIL_MACROS=y
BR2_PACKAGE_ETHTOOL=y
BR2_PACKAGE_IFTOP=y
BR2_PACKAGE_IPERF=y
BR2_PACKAGE_IPERF3=y
BR2_PACKAGE_IPROUTE2=y
BR2_PACKAGE_IPTABLES_BPF_NFSYNPROXY=y
BR2_PACKAGE_IPTABLES_NFTABLES=y
BR2_PACKAGE_IPUTILS=y
BR2_PACKAGE_NETSNMP=y
BR2_PACKAGE_NETSTAT_NAT=y
BR2_PACKAGE_OPENSSH=y
BR2_PACKAGE_RPCBIND=y
BR2_PACKAGE_SSHPASS=y
BR2_PACKAGE_STRONGSWAN=y
BR2_PACKAGE_TCPDUMP=y
BR2_PACKAGE_TCPDUMP_SMB=y
BR2_PACKAGE_BASH=y
BR2_PACKAGE_ZSH=y
BR2_PACKAGE_FILE=y
BR2_PACKAGE_SUDO=y
BR2_PACKAGE_TIME=y
BR2_PACKAGE_TMUX=y
BR2_PACKAGE_WHICH=y
BR2_PACKAGE_ATOP=y
BR2_PACKAGE_COREUTILS=y
BR2_PACKAGE_COREUTILS_INDIVIDUAL_BINARIES=y
BR2_PACKAGE_DOCKER_CLI=y
BR2_PACKAGE_DOCKER_COMPOSE=y
BR2_PACKAGE_DOCKER_CONTAINERD_DRIVER_BTRFS=y
BR2_PACKAGE_DOCKER_ENGINE=y
BR2_PACKAGE_DOCKER_ENGINE_EXPERIMENTAL=y
BR2_PACKAGE_DOCKER_ENGINE_DRIVER_BTRFS=y
BR2_PACKAGE_DOCKER_ENGINE_DRIVER_DEVICEMAPPER=y
BR2_PACKAGE_DOCKER_ENGINE_DRIVER_VFS=y
BR2_PACKAGE_FTOP=y
BR2_PACKAGE_HTOP=y
BR2_PACKAGE_LXC=y
BR2_PACKAGE_PROCPS_NG=y
BR2_PACKAGE_SYSTEMD_ANALYZE=y
# BR2_PACKAGE_SYSTEMD_TIMESYNCD is not set
BR2_PACKAGE_TAR=y
BR2_PACKAGE_UTIL_LINUX_KILL=y
BR2_PACKAGE_UTIL_LINUX_SCHEDUTILS=y
BR2_PACKAGE_VIM=y
BR2_TARGET_ROOTFS_CPIO=y
BR2_TARGET_ROOTFS_CPIO_GZIP=y
BR2_TARGET_ROOTFS_CPIO_UIMAGE=y
BR2_TARGET_ROOTFS_EXT2=y
BR2_TARGET_ROOTFS_EXT2_3=y
BR2_TARGET_ROOTFS_EXT2_SIZE="828M"
BR2_TARGET_ROOTFS_JFFS2=y
```

## SRC-GNB-PLFM-B0-v1.5.0-RC2.1/linux/Documentation/devicetree/bindings/misc/edgeq,raptor2-doorbell.txt
```
This is a sample driver to show how we can initialize a device and make use of
interrupts to communicate between Linux and Zephyr.

Example of device tree node:

doorbell0: raptor2_doorbell@deadbeef {
	compatible = "edgeq,raptor2-doorbell";
	reg = <0x00 0xdeadbeef 0x0 0x01>;
	interrupts = <GIC_SPI 254 IRQ_TYPE_LEVEL_HIGH>, /* Linux IRQ */
		     <GIC_SPI 255 IRQ_TYPE_LEVEL_HIGH>; /* Zephyr IRQ */
	zirq = <255>;
	label = "DOORBELL_0";
	status = "okay";
};

Configurations needed to enable driver:

CONFIG_RAPTOR2_DOORBELL=y
```

## SRC-GNB-PLFM-B0-v1.5.0-RC2.1/linux/Documentation/devicetree/bindings/net/edgeq,xgbe.yaml
```yaml
# SPDX-License-Identifier: GPL-2.0-only OR BSD-2-Clause
%YAML 1.2
---
$id: http://devicetree.org/schemas/net/edgeq,xgbe.yaml#
$schema: http://devicetree.org/meta-schemas/core.yaml#

title: EdgeQ Raptor XGBE Device Tree Bindings

maintainers:
  - Feng Kan <feng.kan@edgeq.io>

# Select every compatible, including the deprecated ones. This way, we
# will be able to report a warning when we have that compatible, since
# we will validate the node thanks to the select, but won't report it
# as a valid value in the compatible property description
select:
  properties:
    compatible:
      contains:
        enum:
          - edgeq,xgbe

  required:
    - compatible

properties:

  # We need to include all the compatibles from schemas that will
  # include that schemas, otherwise compatible won't validate for
  # those.
  compatible:
    contains:
      enum:
        - edgeq,xgbe

  reg:
    minItems: 3
    maxItems: 6

  interrupts:
    minItems: 1
    maxItems: 3
    items:
      - description: Combined signal for various interrupt events

  interrupt-names:
    minItems: 1
    maxItems: 3
    items:
      - const: macirq

  clocks:
    minItems: 1
    maxItems: 3
    additionalItems: true
    items:
      - description: MAC main clock
      - description: PTP reference clock.

  clock-names:
    minItems: 1
    maxItems: 5
    additionalItems: true
    contains:
      enum:
        - pclk
        - ptp_ref

required:
  - compatible
  - reg
  - interrupts
  - interrupt-names
  - phy-mode
```

## SRC-GNB-PLFM-B0-v1.5.0-RC2.1/linux/Documentation/devicetree/bindings/pci/raptor2-pcie-ep.txt
```
* Raptor PCIe Endpoint Controller DT description

Required properties:
- compatible: Should contain "raptor2-pcie-ep"
- reg: sixregister ranges as listed in the reg-names property
- reg-names: Must include the following names
      - "dbi"
      - "dbi2"
      - "atu"
      - "addr_space"
      - "br_up"
      - "lk_reg"

dma-coherent: Indicates whether DMA operations are coherent.
num-lanes: Number of PCIe lanes used by the endpoint.
status: Status of the device, either "disabled" or "enabled".
dma-ch: Number of DMA channels available.
max-ch-mem: Maximum memory size for each DMA channel.
ddr-addr: DDR address for the device.
ddr-size: DDR size for the device.
dma-ll-addr: DDR address offset for the DMA Linked List registers.
dma-ll-size: Size of the DMA Linked List.
hdma-reg-addr: HDMA address for the device.
hdma-reg-size: HDMA size for the device.
ep-off-addr: DDR address offset for the endpoint global region.
ep-off-size: Size of the endpoint global region.

Optional Property:
- max-functions: Maximum number of functions that can be configured (default 1).



pcie_ep0: pcie-ep@3C600000 {
		compatible = "raptor2-pcie-ep";
		reg = <0x0 0x3C600000 0x0 0x100000>, /* IP reg 1 DBI SZ 1MB */
				<0x0 0x3C800000 0x0 0x100000>, /* IP reg 2 DBI2 SZ 1MB */
				<0x0 0x3C900000 0x0 0x80000>, /* IP reg ATU SZ 512K */
				<0x40 0x00000000 0x1 0x00000000>, /* Config space 256GB SZ 4GB */
				<0x0 0x3CB00000 0x0 0x20000>, /* Port Bringup Configuration */
				<0x0 0x3C400000 0x0 0x40000>; /* Link4 Configuration */
		reg-names = "dbi", "dbi2", "atu", "addr_space", "br_up", "lk_reg";
		dma-coherent;
		raptor2_early_init;
		num-lanes = <4>;
		status = "disabled";
		dma-ch = <0x10>; /*16 DMA Channels R/W*/
		max-ch-mem = <0x8000000>; /*128MB~96MB with some headroom*/
		ddr-addr = <0x8 0x00000000>; /*DDR Address-BAR2*/
		ddr-size = <0x2 0x00000000>; /*DDR Size-BAR2 8GB*/
		dma-ll-addr = <0x8 0xDAC00000>; /*DDR ADR + DMA LL Reg Offset*/
		dma-ll-size = <0x8000000>; /*128MB*/
		hdma-reg-addr = <0x3C980000>; /*HDMA Address-BAR2*/
		hdma-reg-size = <0x80000>; /*HDMA Size-BAR0 512KB*/
		ep-off-addr = <0xF80000>; /*DDR ADDR + EP Glb Region Offset*/
		ep-off-size	= <0x40000>; /*DDR ADDR + EP Glb Region Offset 256KB*/
	};
```

## SRC-GNB-PLFM-B0-v1.5.0-RC2.1/linux/Documentation/devicetree/bindings/pci/raptor2-pcie-ep.yaml
```yaml
# SPDX-License-Identifier: (GPL-2.0-only OR BSD-2-Clause)
%YAML 1.2
---
$id: http://devicetree.org/schemas/pci/raptor2-pcie-ep.yaml#
$schema: http://devicetree.org/meta-schemas/core.yaml#

title: Raptor2 PCI Endpoint Controller Schema

description: |
  This YAML file describes the device tree binding for the Raptor2 PCIe Endpoint.

maintainers:
  - Aman Sharma <aman.Sharma@edgeq.io>
  - Aakash Verma <aakash.verma@edgeq.io>

properties:
  $nodename:
    pattern: "^raptor2-pcie-ep@"


  reg:
    maxItems: 6
    items:
      - description: IP reg 1 DBI
      - description: IP reg 2 DBI2
      - description: IP reg ATU
      - description: Config space
      - description: Port Bringup Configuration
      - description: Link4 Configuration

  reg-names:
    items:
      - const: "dbi"
      - const: "dbi2"
      - const: "atu"
      - const: "addr_space"
      - const: "br_up"
      - const: "lk_reg"

  dma-coherent: true

  num-lanes:
    description: Maximum number of functions that can be configured
    $ref: /schemas/types.yaml#/definitions/uint8
    minimum: 1
    default: 1
    maximum: 255

  dma-ch:
    description: Maximum number of DMA channel that can be configured
    $ref: /schemas/types.yaml#/definitions/uint32
    type: integer
    minimum: 1
    default: 8
    maximum: 32

  max-ch-mem:
    description: Maximum memory allocated to channels
    $ref: /schemas/types.yaml#/definitions/uint32
    type: integer
    minimum: 1
    default: 131072
    minimum: 131072
    maximum: 2147483647

  ddr-addr:
    description: BAR2 DDR address
    $ref: /schemas/types.yaml#/definitions/uint64
    type: integer
    minimum: 1
    default: 34359738368
    maximum: 34359738368

  ddr-size:
    description: BAR2 DDR size
    $ref: /schemas/types.yaml#/definitions/uint64
    type: integer
    minimum: 1
    default: 8589934592
    maximum: 8589934592

  dma-ll-addr:
    description: Link List for DMA, in DDR address
    $ref: /schemas/types.yaml#/definitions/uint64
    type: integer
    minimum: 0
    maximum: 4294967295

  dma-ll-size:
    description: Link List for DMA, in DDR size
    $ref: /schemas/types.yaml#/definitions/uint64
    type: integer
    minimum: 0
    maximum: 2147483647

  hdma-reg-addr:
    description: HDMA reg address
    $ref: /schemas/types.yaml#/definitions/uint32
    type: integer
    minimum: 0
    maximum: 4294967295

  hdma-reg-size:
    description: HDMA reg size
    $ref: /schemas/types.yaml#/definitions/uint32
    type: integer
    minimum: 0
    maximum: 524287

  ep-off-addr:
    description: Endpoint Offset Addr
    $ref: /schemas/types.yaml#/definitions/uint64
    type: integer
    minimum: 0
    maximum: 16777215

  ep-off-size:
    description: Endpoint Offset Size
    $ref: /schemas/types.yaml#/definitions/uint64
    type: integer
    minimum: 0
    maximum: 262143

  max-functions:
    description: Maximum number of functions that can be configured
    $ref: /schemas/types.yaml#/definitions/uint8
    type: integer
    minimum: 1
    default: 1
    maximum: 255

  max-link-speed:
    $ref: /schemas/types.yaml#/definitions/uint32
    enum: [ 1, 2, 3, 4 ]

  num-lanes:
    description: maximum number of lanes
    $ref: /schemas/types.yaml#/definitions/uint32
    type: integer
    minimum: 1
    default: 1
    maximum: 16

required:
  - compatible
  - reg
  - reg-names
  - dma-coherent
  - num-lanes
  - status

additionalProperties: false
```
