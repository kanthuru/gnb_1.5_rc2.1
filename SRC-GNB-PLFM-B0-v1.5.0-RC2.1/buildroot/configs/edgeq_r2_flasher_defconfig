## SRC-GNB-PLFM-B0-v1.5.0-RC2.1/u-boot/board/edgeq/raptor2/Kconfig
```kconfig
if TARGET_EQ_RAPTOR2 || TARGET_EQ_RAPTOR2_FPGA || TARGET_EQ_RAPTOR2_SINGLE_PPU_CLUSTER || TARGET_EQ_RAPTOR2_A0_EVB || TARGET_EQ_RAPTOR2_A0_PEGASUS || TARGET_EQ_RAPTOR2_B0_FPGA || TARGET_EQ_RAPTOR2_B0_TITAN || TARGET_EQ_RAPTOR2_B0_HAWK || TARGET_EQ_RAPTOR2_B0_PEGASUS

config SYS_BOARD
	default "raptor2"

config SYS_VENDOR
	default "edgeq"

config SYS_SOC
	default "raptor2"

config SYS_CONFIG_NAME
	default "edgeq_raptor2"

config SYS_TEXT_BASE
	default 0x90000000 if SPL
	default 0x90000000

config SPL_TEXT_BASE
	default 0x91000000

config BOARD_SPECIFIC_OPTIONS
	def_bool y
	imply CMD_DHCP
	imply CMD_EXT2
	imply CMD_EXT4
	imply CMD_FAT
	imply CMD_FS_GENERIC
	imply CMD_NET
	imply CMD_PING
	imply CMD_DM
	imply CMD_MMC
#	imply CMD_GPT
#	imply CMD_I2C
#	imply CMD_NAND
#	imply CMD_PCI
#	imply CMD_USB
#	imply CMD_CACHE
	imply DOS_PARTITION
	imply EFI_PARTITION
	imply ISO_PARTITION
	imply BOARD_LATE_INIT
	imply OF_BOARD_SETUP
	imply SMP
#	imply PCIE_ECAM_GENERIC
	imply NVME
	imply SPL_RAM_SUPPORT
	imply SPL_RAM_DEVICE

config CMD_RAPTOR_FUSE
       bool "Enable raptor efuse"
       depends on ARCH_RAPTOR2
       default n
       help
         enables raptor soc fuse commands

config CMD_SET_VDD
        bool "Enable setvdd cmd"
        default n
        help
          Support for PMIC set vdd for buck2
config I2C_DCTCXO
	   bool "Probe DCTCXO on I2C bus"
	   default n
	   help
		  Set to y only if DCTCXO exists on the I2C bus

config CMD_SET_AVS
        bool "Enable set_avs cmd"
        default n
        help
          Support for PMIC set AVS enable

config CMD_BSS_REG_READ_WRITE
        bool "Enable bss_reg read/write cmd"
        default n
        help
          Support for BSS reg read/write which are not accessible
	  from e1
endif
```

## SRC-GNB-PLFM-B0-v1.5.0-RC2.1/u-boot/configs/edgeq_raptor2_b0_fpga_defconfig
```kconfig
CONFIG_ARM=y
# CONFIG_ARM64_SUPPORT_AARCH32 is not set
CONFIG_ARCH_RAPTOR2=y
CONFIG_SYS_TEXT_BASE=0x801C00000
CONFIG_ENV_SIZE=0x2000
CONFIG_NR_DRAM_BANKS=1
CONFIG_TARGET_EQ_RAPTOR2_B0=y
CONFIG_TARGET_EQ_RAPTOR2_B0_FPGA=y
CONFIG_DISTRO_DEFAULTS=y
CONFIG_FIT=y
CONFIG_BOOTDELAY=3
CONFIG_USE_BOOTARGS=y
CONFIG_BOOTARGS="console=ttyS0,115200 root=/dev/ram0 earlycon=edgeq8250,mmio32,0x6E450000"
CONFIG_DEFAULT_DEVICE_TREE="edgeq_raptor2_b0_fpga"
CONFIG_OF_LIST="edgeq_raptor2_b0_fpga"
CONFIG_SYS_CONFIG_NAME="edgeq_raptor2"
CONFIG_DM=y
CONFIG_NETDEVICES=y
CONFIG_BAUDRATE=19200
CONFIG_DM_ETH=y
CONFIG_DWXGMAC=y
#CONFIG_EQXPCS=y
CONFIG_DM_SERIAL=y
CONFIG_PL01X_SERIAL=y
CONFIG_SYS_NS16550=y
CONFIG_SYS_NS16550_SERIAL=y
# CONFIG_CMD_SMC=y
CONFIG_DM_SPI=y
CONFIG_ATCSPI200_SPI=y
CONFIG_DM_SPI_FLASH=y
CONFIG_SPI_FLASH_MACRONIX=y
CONFIG_SPI_FLASH_STMICRO=y
CONFIG_MTD_SPI_NAND=y
CONFIG_SPI_FLASH_MTD=y
CONFIG_DM_MMC=y
CONFIG_MTD=y
CONFIG_DM_MTD=y
CONFIG_CMD_SPI=y
CONFIG_CMD_SF=y
CONFIG_CLK=y
CONFIG_CMD_RAPTOR_FUSE=y
CONFIG_CMD_SMC=y
CONFIG_CMD_MEMTEST=y
CONFIG_CMD_CACHE=y
CONFIG_MMC=y
CONFIG_DM_MMC=y
CONFIG_CMD_MMC=y
CONFIG_MMC_SDHCI=y
CONFIG_MMC_SDHCI_RAPTOR2=y
CONFIG_CMD_EXT4_WRITE=y
CONFIG_FAT_WRITE=y
#CONFIG_MMC_SDHCI_ADMA=y
#CONFIG_DMA_ADDR_T_64BIT=y
```
